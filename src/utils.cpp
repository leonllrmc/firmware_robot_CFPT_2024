#include <Arduino.h>

#include <math.h>

#define DISTANCE_BETWEEN_SENSORS 187

typedef unsigned char uint8_t;

// Generated by the unholy source of chatGPT
unsigned char reverseBits(unsigned char num) {
   unsigned char reversedNum = 0;
   unsigned char temp;
   
   int i = 0;

   // Reverse the first 4 bits
   for (; i < 4; i++) {
      temp = (num & (1 << i));
      if(temp)
         reversedNum |= (1 << ((4 - 1) - i));
   }

   // Copy the last 4 bits
   reversedNum |= (num & (0xF0));

   return reversedNum;
}

unsigned char getBitNumber(unsigned char byteToCount)
{
   unsigned char bitNumber;

   for(unsigned char i = 0; i < 7; i++)
   {
      bitNumber += ((byteToCount & (0x01 << i)) ? 1 : 0);
   }

   return bitNumber;
}

uint8_t countBits(uint8_t num) {
   uint8_t total = 0;

   for(uint8_t i = 0; i < 8; i++)
   {
      total += (num & (0x01 << i)) >> i;
   }

   return total;
}

int getAngleFrom2Sensor(int distance0, int distance1)
{
   if(abs(distance0 - distance1) < 1)
   {
      Serial.println("Found no difference, skiping...");

      return 0;
   }

   double radianAngle = atan((double)(distance0 - distance1)/(double)DISTANCE_BETWEEN_SENSORS);

   Serial.println("Got " + String(radianAngle) + " as radian angle");

   return ((radianAngle * (double)180) / (double)3.14159);
}